## Kconfig
```kconfig
config ZMK_PHYSICAL_LAYOUTS_FEATURE
    bool "Enable physical layout modules feature"

if ZMK_PHYSICAL_LAYOUTS_FEATURE

config ZMK_PHYSICAL_LAYOUTS_FEATURE_STUDIO_RPC
    bool "Enable physical layout modules custom Studio RPC"
    depends on ZMK_STUDIO

endif
```

## dts/bindings/cormoran,physical-layout-rotary-encoder.yaml
```yaml
# Copyright (c) 2026 The ZMK Contributors
# SPDX-License-Identifier: MIT

description: Describes one rotary encoder in a physical rotary encoder bundle.

compatible: "cormoran,physical-layout-rotary-encoder"

properties:
  x:
    type: int
    required: true
    description: X position in the same coordinate units as ZMK key physical layouts.

  y:
    type: int
    required: true
    description: Y position in the same coordinate units as ZMK key physical layouts.

  size:
    type: int
    required: true
    description: Rotary encoder diameter in the same coordinate units as ZMK key physical layouts.
```

## dts/bindings/cormoran,physical-layout-touch-pad.yaml
```yaml
# Copyright (c) 2026 The ZMK Contributors
# SPDX-License-Identifier: MIT

description: Describes the physical location of a touch pad for custom ZMK Studio rendering.

compatible: "cormoran,physical-layout-touch-pad"

properties:
  display-name:
    type: string
    required: true

  width:
    type: int
    required: true

  height:
    type: int
    required: true

  x:
    type: int
    required: true

  y:
    type: int
    required: true

  r:
    type: int
    default: 0
    description: Rotation angle in centi-degrees.

  rx:
    type: int
    default: 0
    description: X coordinate of the rotation origin.

  ry:
    type: int
    default: 0
    description: Y coordinate of the rotation origin.

  linked-device-identifiers:
    type: string-array
    required: true

  linked-subsystems:
    type: string-array
    required: true
```

## dts/bindings/cormoran,physical-layout-trackball.yaml
```yaml
# Copyright (c) 2026 The ZMK Contributors
# SPDX-License-Identifier: MIT

description: Describes the physical location of a trackball for custom ZMK Studio rendering.

compatible: "cormoran,physical-layout-trackball"

properties:
  display-name:
    type: string
    required: true

  x:
    type: int
    required: true
    description: X position in the same coordinate units as ZMK key physical layouts.

  y:
    type: int
    required: true
    description: Y position in the same coordinate units as ZMK key physical layouts.

  size:
    type: int
    required: true
    description: Trackball diameter in the same coordinate units as ZMK key physical layouts.

  linked-device-identifiers:
    type: string-array
    required: true

  linked-subsystems:
    type: string-array
    required: true
```

## dts/bindings/zmk,physical-layout-custom-module.yaml
```yaml
# Copyright (c) 2026 The ZMK Contributors
# SPDX-License-Identifier: MIT

description: Describes the physical location of a custom module for custom ZMK Studio rendering.

compatible: "zmk,physical-layout-custom-module"

properties:
  display-name:
    type: string
    required: true

  type:
    type: string
    required: true
    description: Custom module type label.

  width:
    type: int
    required: true

  height:
    type: int
    required: true

  x:
    type: int
    required: true

  y:
    type: int
    required: true

  r:
    type: int
    default: 0
    description: Rotation angle in centi-degrees.

  rx:
    type: int
    default: 0
    description: X coordinate of the rotation origin.

  ry:
    type: int
    default: 0
    description: Y coordinate of the rotation origin.

  linked-device-identifiers:
    type: string-array
    required: true

  linked-subsystems:
    type: string-array
    required: true
```

## dts/bindings/zmk,physical-layout-device.yaml
```yaml
# Copyright (c) 2026 The ZMK Contributors
# SPDX-License-Identifier: MIT

description: |
  Describes the physical location of a non-keyboard module, such as a
  trackball, rotary encoder, or trackpad, for custom ZMK Studio rendering.

compatible: "zmk,physical-layout-device"

properties:
  display-name:
    type: string
    required: true
    description: Human readable label for the physical device.

  device-type:
    type: string
    required: true
    description: Physical device kind, such as trackball, encoder, or trackpad.

  width:
    type: int
    required: true
    description: Width in the same coordinate units as ZMK key physical layouts.

  height:
    type: int
    required: true
    description: Height in the same coordinate units as ZMK key physical layouts.

  x:
    type: int
    required: true
    description: X position in the same coordinate units as ZMK key physical layouts.

  y:
    type: int
    required: true
    description: Y position in the same coordinate units as ZMK key physical layouts.

  r:
    type: int
    default: 0
    description: Rotation angle in tenths of degrees.

  rx:
    type: int
    default: 0
    description: X coordinate of the rotation origin.

  ry:
    type: int
    default: 0
    description: Y coordinate of the rotation origin.

  linked-devices:
    type: phandles
    description: Devices that provide functionality for this physical device.

  linked-subsystems:
    type: string-array
    description: Custom Studio RPC subsystem identifiers matching linked-devices by index.
```

## dts/bindings/zmk,physical-layout-rotary-encoder.yaml
```yaml
# Copyright (c) 2026 The ZMK Contributors
# SPDX-License-Identifier: MIT

description: Describes one rotary encoder in a physical rotary encoder bundle.

compatible: "zmk,physical-layout-rotary-encoder"

properties:
  x:
    type: int
    required: true
    description: X position in the same coordinate units as ZMK key physical layouts.

  y:
    type: int
    required: true
    description: Y position in the same coordinate units as ZMK key physical layouts.

  size:
    type: int
    required: true
    description: Rotary encoder diameter in the same coordinate units as ZMK key physical layouts.

  r:
    type: int
    default: 0
    description: Rotation angle in tenths of degrees.

  rx:
    type: int
    default: 0
    description: X coordinate of the rotation origin.

  ry:
    type: int
    default: 0
    description: Y coordinate of the rotation origin.
```

## dts/bindings/zmk,physical-layout-rotary-encoders.yaml
```yaml
# Copyright (c) 2026 The ZMK Contributors
# SPDX-License-Identifier: MIT

description: Bundles physical rotary encoders for mapping to ZMK's official encoder indexes.

compatible: "zmk,physical-layout-rotary-encoders"

properties:
  display-name:
    type: string
    required: true

  encoders:
    type: phandles
    required: true
    description: Rotary encoder physical definitions in the order used for mapping.
```

## dts/bindings/zmk,physical-layout-trackball.yaml
```yaml
# Copyright (c) 2026 The ZMK Contributors
# SPDX-License-Identifier: MIT

description: Describes the physical location of a trackball for custom ZMK Studio rendering.

compatible: "zmk,physical-layout-trackball"

properties:
  display-name:
    type: string
    required: true

  x:
    type: int
    required: true
    description: X position in the same coordinate units as ZMK key physical layouts.

  y:
    type: int
    required: true
    description: Y position in the same coordinate units as ZMK key physical layouts.

  size:
    type: int
    required: true
    description: Trackball diameter in the same coordinate units as ZMK key physical layouts.

  r:
    type: int
    default: 0
    description: Rotation angle in tenths of degrees.

  rx:
    type: int
    default: 0
    description: X coordinate of the rotation origin.

  ry:
    type: int
    default: 0
    description: Y coordinate of the rotation origin.

  linked-device-identifiers:
    type: string-array
    required: true

  linked-subsystems:
    type: string-array
    required: true
```
